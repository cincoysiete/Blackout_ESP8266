// LIBRERIAS
  #include <ESP8266WiFi.h>
  #include <ESP8266WebServer.h>
  #include <WiFiClientSecure.h>
  #include <Wire.h>
  #include <Adafruit_GFX.h>
  #include <Adafruit_SSD1306.h>
  #include <NTPClient.h>
  #include <WiFiUdp.h>
  #include <UniversalTelegramBot.h>
  #include <FS.h>
  #include <LittleFS.h>

// CONFIGURACION DE LA PANTALLA OLED
  #define SCREEN_WIDTH 128
  #define SCREEN_HEIGHT 64
  #define OLED_RESET    -1
  #define SCREEN_ADDRESS 0x3C
  Adafruit_SSD1306 display(SCREEN_WIDTH, SCREEN_HEIGHT, &Wire, OLED_RESET);

// CONFIGURACION NTP PARA RELOJ
  WiFiUDP ntpUDP;
  NTPClient timeClient(ntpUDP, "pool.ntp.org", 3600, 60000);

// DESPLIEGA EL SERVIDOR LOCAL
  ESP8266WebServer server(80);

// INICIALIZACION DE VARIABLES
  unsigned long lastConnectionTime = 0;
  unsigned long offlineMinutes = 0;
  bool wasConnected = false;
  bool shouldSendHello = true;
  unsigned long lastHourlyMessageTime = 0;
  const int MAX_CONFIG_LENGTH = 128;
  char ssid[MAX_CONFIG_LENGTH];
  char password[MAX_CONFIG_LENGTH];
  char* serverUrl;
  unsigned long hourlyInterval;
  String desconectadoWifi;
  String desconectadoLuz;
  String conectado;
  unsigned long control;
  String telegramo;
  #include "blackout.h"
  WiFiClientSecure clientTelegram;
  UniversalTelegramBot bot(BOT_TOKEN, clientTelegram);

// PROTOTIPOS DE FUNCIONES
  void handleFavicon();
  void handleRoot();
  void handleStatus();
  void handleRestart();
  void handleGetLastSendTime();
  void sendToServer(String message);
  void connectToWiFi();
  void sendTelegramMessage(String message);
  void loadConfig(); 
  void saveConfig();
  void handleSave();
  String obtenerHoraFormateada();
  String urlEncode(String str);


void setup() {
  Serial.begin(115200);

  if (!LittleFS.begin()) {
    Serial.println("Error al montar LittleFS");
    return;
  }
  Serial.println("LittleFS montado correctamente");

  // LittleFS.remove("/config.txt");

  loadConfig();

  server.on("/favicon.ico", handleFavicon);

  configTime(0, 0, "pool.ntp.org");
  setenv("TZ", "CET-1CEST-2,M3.5.0/02:00:00,M10.5.0/03:00:00", 1);
  tzset();

  timeClient.begin();
  timeClient.update();

  connectToWiFi();
  server.on("/", handleRoot);
  server.on("/status", handleStatus);
  server.on("/restart", handleRestart);
  server.on("/getLastSendTime", handleGetLastSendTime);
  server.on("/save", handleSave);  // Nueva: Para guardar la configuracion
  server.begin();

  configTime(0, 0, "pool.ntp.org");

  clientTelegram.setInsecure(); // Solo para desarrollo - no usar en produccion

  // MOSTRAMOS INFO EN LA LCD. BLACKOUT
  Wire.begin();
  display.begin(SSD1306_SWITCHCAPVCC, SCREEN_ADDRESS);
  display.clearDisplay();
  display.setRotation(0);
  display.setTextSize(2);
  display.setTextColor(SSD1306_WHITE);
  display.setCursor(0, 0);
  display.println("blackout");
  display.display();
}

void loop() {
  timeClient.update();
  String horaActual = obtenerHoraFormateada();

  // MOSTRAMOS INFO EN LA LCD. HORA
  display.setTextSize(2);
  display.setCursor(0, 50);
  display.setTextColor(WHITE);
  display.fillRect(0, 50, 150, 20, BLACK);
  display.println(horaActual);
  display.display();
  display.setTextSize(1);
  display.setCursor(0, 25);
  display.fillRect(0, 25, 100, 10, BLACK);
  display.println(WiFi.localIP().toString());
  display.display();

  server.handleClient();
  bool isConnected = WiFi.status() == WL_CONNECTED;

  if (isConnected) {
    if (!wasConnected) {
      if (offlineMinutes > 0) {
        sendToServer("nowifi;" + desconectadoWifi + ";" + calcularTiempoSinLuz());
        sendTelegramMessage("ESP: " + desconectadoWifi + " " + calcularTiempoSinLuz());
        offlineMinutes = 0;
      }
      wasConnected = true;
    }

    // Enviar "conectado" cada cierto tiempo
    if (millis() - lastHourlyMessageTime >= hourlyInterval) {
      sendToServer("Bien;"+conectado+";;"+telegramo);
      sendTelegramMessage("ESP: " + conectado);
      lastHourlyMessageTime = millis();
    }

    if (millis() - lastConnectionTime >= control || shouldSendHello) {
      if (shouldSendHello) {
        sendToServer("noluz;" + desconectadoLuz + ";" + calcularTiempoSinLuz());
        // sendToServer("telegramo;"+telegramo);
        sendTelegramMessage("ESP: " + desconectadoLuz + " " + calcularTiempoSinLuz());
        shouldSendHello = false;
      } else {
        sendToServer("Conectado;🟢Conectado;;"+telegramo);
        guardarHoraConexion();
        delay(1000);
      }
      lastConnectionTime = millis();
    }
  } else {
    wasConnected = false;
    static unsigned long lastMinuteCheck = 0;
    if (millis() - lastMinuteCheck >= control) {
      offlineMinutes++;
      lastMinuteCheck = millis();

    }

    static unsigned long lastReconnectAttempt = 0;
    if (millis() - lastReconnectAttempt >= (control / 2)) {
      lastReconnectAttempt = millis();
      connectToWiFi();
    }

    display.setTextSize(1);
    display.setCursor(0, 25);
    display.fillRect(0, 25, 100, 10, BLACK);
    display.println("Desconectado");
    display.display();
  }
}

// ENVIAR MENSAJES A TELEGRAM
void sendTelegramMessage(String message) {
  if (WiFi.status() == WL_CONNECTED && telegramo=="si") {
    bot.sendMessage(CHAT_ID, message, "");
  }
}

// CONEXION AL WIFI
void connectToWiFi() {
  WiFi.begin(ssid, password);
  int attempts = 0;
  while (WiFi.status() != WL_CONNECTED && attempts < 20) {
    delay(500);
    attempts++;
  }
}

// CALCULA EL TIEMPO SIN LUZ
String calcularTiempoSinLuz() {
  File file = LittleFS.open("/hora_conexion.txt", "r");
  if (!file) {
    return "Error: No se pudo leer la hora guardada";
  }
  String horaGuardada = file.readStringUntil('\n');
  file.close();

  String horaActual = obtenerHoraFormateada();
  // Convertir HH:MM:SS a segundos
  int h1 = horaGuardada.substring(0, 2).toInt();
  int m1 = horaGuardada.substring(3, 5).toInt();
  int s1 = horaGuardada.substring(6, 8).toInt();
  int segundosGuardados = h1 * 3600 + m1 * 60 + s1;
  int h2 = horaActual.substring(0, 2).toInt();
  int m2 = horaActual.substring(3, 5).toInt();
  int s2 = horaActual.substring(6, 8).toInt();
  int segundosActuales = h2 * 3600 + m2 * 60 + s2;

  int diferencia = segundosActuales - segundosGuardados;
  if (diferencia < 0) diferencia += 86400;  // Ajuste si pasa la medianoche

  // Formatear diferencia como "HH:MM:SS"
  int horas = diferencia / 3600;
  int minutos = (diferencia % 3600) / 60;
  int segundos = diferencia % 60;

  char buffer[20];
  sprintf(buffer, "%02d:%02d:%02d", horas, minutos, segundos);
  return String(buffer);
}

// FORMATEAR HORA
String obtenerHoraFormateada() {
  timeClient.update();

  int hora = timeClient.getHours();
  int minutos = timeClient.getMinutes();
  int segundos = timeClient.getSeconds();

  // Obtener el dia de la semana (0=Domingo, 1=Lunes, etc.)
  int diaSemana = timeClient.getDay();
  // Obtener fecha actual (alternativa para ESP8266)
  time_t now = time(nullptr);
  struct tm *timeinfo = localtime(&now);
  int mes = timeinfo->tm_mon + 1;  // tm_mon es 0-11
  int dia = timeinfo->tm_mday;
  // Ajuste para horario de verano (ejemplo para España)
  if (mes > 3 && mes < 10) {
    // Estamos en horario de verano (abril-septiembre)
    hora += 1;
  } else if (mes == 3) {
    // Marzo: a partir del ultimo domingo (simplificado)
    if (dia >= 25) {  // Aproximacion para ultimo domingo de marzo
      hora += 1;
    }
  } else if (mes == 10) {
    // Octubre: antes del ultimo domingo (simplificado)
    if (dia < 25) {  // Aproximacion para ultimo domingo de octubre
      hora += 1;
    }
  }

  // Ajustar si pasamos de medianoche
  if (hora >= 24) {
    hora -= 24;
  }

  // Añadir ceros iniciales
  String strHora = (hora < 10) ?
                 "0" + String(hora) : String(hora);
  String strMinutos = (minutos < 10) ? "0" + String(minutos) : String(minutos);
  String strSegundos = (segundos < 10) ? "0" + String(segundos) : String(segundos);
  return strHora + ":" + strMinutos + ":" + strSegundos;
}

// GUARDAR HORA EN ARCHIVO
void guardarHoraConexion() {
  File file = LittleFS.open("/hora_conexion.txt", "w");
  if (!file) {
    Serial.println("Error al abrir el archivo para escritura");
    return;
  }
  String horaActual = obtenerHoraFormateada();
  file.println(horaActual);
  file.close();
  Serial.println("Hora guardada: " + horaActual);
}

// CODIFICA MENSAJE QUE SE ENVIA POR GET AL SERVIDOR
String urlEncode(String str) {
  String encodedString = "";
  char c;
  char code0;
  char code1;
  for (unsigned int i = 0; i < str.length(); i++) {
    c = str.charAt(i);
    if (c == ' ') {
      encodedString += '+';
    } else if (isalnum(c)) {
      encodedString += c;
    } else {
      code1 = (c & 0xf) + '0';
      if ((c & 0xf) > 9) {
        code1 = (c & 0xf) - 10 + 'A';
      }
      c = (c >> 4) & 0xf;
      code0 = c + '0';
      if (c > 9) {
        code0 = c - 10 + 'A';
      }
      encodedString += '%';
      encodedString += code0;
      encodedString += code1;
    }
  }
  return encodedString;
}

// ENVIA LOS MENSAJES AL SERVIDOR
void sendToServer(String message) {
  if (WiFi.status() != WL_CONNECTED) {
    return;
  }

  WiFiClientSecure client;
  client.setInsecure(); // Solo para desarrollo - no usar en produccion


  Serial.println(serverName);
  if (!client.connect(serverName, 443)) {
    Serial.println("No hay conexion");
    telegramo="si";
    return;
  } 
  // Serial.println(telegramo);

  // CODIFICAMOS EL MENSAJE ENVIADO AL SERVIDOR
  String urlEncodedMessage = urlEncode(message);
  // HACEMOS LA PETICION AL SERVIDOR
  String request = String("GET /blackout/index.php?msg=") + urlEncodedMessage + " HTTP/1.1\r\n" +
                   "Host: " + serverName + "\r\n" +
                   "User-Agent: ESP8266\r\n" +
                   "Connection: close\r\n\r\n";
  client.print(request);

  // Esperamos la respuesta del servidor
  unsigned long timeout = millis();
  while (client.available() == 0) {
    if (millis() - timeout > 5000) {
      Serial.println("Error: Timeout esperando respuesta");
      client.stop();
      return;
    }
  }

  // Leemos la respuesta línea por línea
  // while (client.available()) {
  //   String line = client.readStringUntil('\r');
  //   // Puedes verificar aquí si la respuesta contiene algún código de éxito (200 OK)
  //   if (line.startsWith("HTTP/1.1 200")) {
  //     Serial.println("Mensaje recibido correctamente por el servidor");
  //   }
  // }

  client.stop();
}

// SERVIDOR WEB LOCAL (EN LA ESP8266)
void handleRoot() {
    String html = "<!DOCTYPE html><html><head><title>Configuración Blackout</title>";
    html += "<html lang='es'><meta charset='UTF-8'>";
    html += "<meta name='viewport' content='width=device-width, initial-scale=1.0'>";
    html += "<style>";
    html += "body {";
    html += "  font-family: Arial, sans-serif;";
    html += "  background-color: #575757;";
    html += "  color: #e0e0e0;";
    html += "  margin: 0;";
    html += "  padding: 20px;";
    html += "}";
    html += "form {";
    html += "  display: flex;";
    html += "  flex-direction: column;";
    html += "  max-width: 300px;";
    html += "  margin: 20px auto;";
    html += "  background-color: #3e3e3e;";
    html += "  padding: 20px;";
    html += "  border-radius: 8px;";
    html += "  box-shadow: 0 2px 10px rgba(0,0,0,0.5);";
    html += "}";
    html += "h1 {";
    html += "  color: #a0a0a0;";
    html += "}";
    html += "label {";
    html += "  margin-bottom: 5px;";
    html += "  color: #a0a0a0;";
    html += "}";
    html += "input, button {";
    html += "  margin-bottom: 10px;";
    html += "  padding: 8px;";
    html += "  background-color: #575757;";
    html += "  color: #a0a0a0;";
    html += "  border: 1px solid #444;";
    html += "  border-radius: 4px;";
    html += "}";
    html += "input:focus {";
    html += "  outline: none;";
    html += "  border-color: #3C83ACFF;";
    html += "}";
    html += "input[type='submit'], button {";
    html += "  background-color: #3C83ACFF;";
    html += "  color: white;";
    html += "  border: none;";
    html += "  cursor: pointer;";
    html += "  font-weight: bold;";
    html += "  transition: background-color 0.3s;";
    html += "}";
    html += "input[type='submit']:hover, button:hover {";
    html += "  background-color: #2a6a8a;";
    html += "}";
    html += "button {";
    html += "  margin-top: 10px;";
    html += "}";
    html += "</style>";
    html += "</head><body><div style='text-align:center;'><h12>Configuración Blackout</h2>";
    html += "<form method='POST' action='/save'>";
    html += "<label>SSID de Wifi:</label><input type='text' name='ssid' value='" + String(ssid) + "'><br>";
    html += "<label>Clave de Wifi:</label><input type='password' name='password' value='" + String(password) + "'><br>";
    html += "<label>URL del servidor:</label><input type='text' name='serverUrl' value='" + String(serverUrl ? serverUrl : "") + "'><br>";
    html += "<label>Telegram de normalidad (ms):</label><input type='number' name='hourlyInterval' value='" + String(hourlyInterval) + "'><br>";
    html += "<label>Mensaje para wifi desonectado:</label><input type='text' name='desconectadoWifi' value='" + desconectadoWifi + "'><br>";
    html += "<label>Mensaje para energía desconectada:</label><input type='text' name='desconectadoLuz' value='" + desconectadoLuz + "'><br>";
    html += "<label>Mensaje de todo está bien:</label><input type='text' name='conectado' value='" + conectado + "'><br>";
    html += "<label>Envio de estado cada (ms):</label><input type='number' name='control' value='" + String(control) + "'><br>";
    html += "<label>Activar Telegram (si/no):</label><input type='text' name='telegramo' value='" + telegramo + "'>";
    html += "<input type='submit' value='Guardar Configuración'>";
    html += "</form>";

    html += "<button onclick=\"fetch('/restart').then(() => alert('Reiniciando...'))\">Reiniciar</button><br>";
    html += "</div></body></html>";

    server.send(200, "text/html", html);
}

// GUARDAR CONFIGURACION
void handleSave() {
  if (server.method() == HTTP_POST) {
    Serial.println("Guardando configuración...");
    File configFile = LittleFS.open("/config.txt", "w");
    if (!configFile) {
      server.send(500, "text/plain", "Error al guardar la configuración");
      return;
    }

    // Actualizar las variables con los datos del formulario y escribir en el archivo
    strcpy(ssid, server.arg("ssid").c_str());
    configFile.println("ssid=" + server.arg("ssid"));

    strcpy(password, server.arg("password").c_str());
    configFile.println("password=" + server.arg("password"));

    if (server.hasArg("serverUrl")) {
      if (serverUrl) free(serverUrl);  // Liberar memoria anterior
      serverUrl = strdup(server.arg("serverUrl").c_str());
      configFile.println("serverUrl=" + server.arg("serverUrl"));
    }

    hourlyInterval = server.arg("hourlyInterval").toInt();
    configFile.println("hourlyInterval=" + server.arg("hourlyInterval"));

    desconectadoWifi = server.arg("desconectadoWifi");
    configFile.println("desconectadoWifi=" + server.arg("desconectadoWifi"));

    desconectadoLuz = server.arg("desconectadoLuz");
    configFile.println("desconectadoLuz=" + server.arg("desconectadoLuz"));

    conectado = server.arg("conectado");
    configFile.println("conectado=" + server.arg("conectado"));

    control = server.arg("control").toInt();
    configFile.println("control=" + server.arg("control"));

    telegramo = server.arg("telegramo");
    configFile.println("telegramo=" + server.arg("telegramo"));

    configFile.close();

  String htmla = "<!DOCTYPE html><html><head><title>Configuración Blackout</title>";
  htmla += "<html lang='es'><meta charset='UTF-8'>";
  htmla += "<meta name='viewport' content='width=device-width, initial-scale=1.0'>";
  htmla += "<style>body{font-family:Arial,sans-serif;} form{display:flex;flex-direction:column;max-width:300px;margin:20px auto;}";
  htmla += "input, button{margin-bottom:10px;padding:8px;} label{margin-bottom:5px;}</style>";
  htmla += "</head><body><div style='text-align:center;'><h1>Configuración Blackout</h1>";
    delay(4000);
  htmla += "<br><br>Configuracion guardada.<br><br><a href='#' onclick='history.back(); return false;'>Volver atrás</a>";
  server.send(200, "text/html", htmla);

  } else {
    server.send(405, "text/plain", "Metodo no permitido");
  }
}

// CARGA LA CONFIGURACION DESDE: "/config.txt"
void loadConfig() {
  File configFile = LittleFS.open("/config.txt", "r");
  if (!configFile) {
  #include "config.h"

  }
  while (configFile.available()) {
    String line = configFile.readStringUntil('\n');
    line.trim(); // Eliminar espacios en blanco al final
    int separator = line.indexOf('=');
    if (separator != -1) {
      String key = line.substring(0, separator);
      String value = line.substring(separator + 1);

      // Asignar valores a las variables
      if (key == "ssid") {
        strcpy(ssid, value.c_str());
      } else if (key == "password") {
        strcpy(password, value.c_str());
      } else if (key == "serverUrl") {
        if (serverUrl) free(serverUrl);
        serverUrl = strdup(value.c_str());
        // String url = String(serverUrl);
        // int start = url.indexOf("://") + 3;
        // int end = url.indexOf("/", start);
        // String serverName = url.substring(start, end);
        // free(serverUrl);
        // serverUrl = strdup(serverName.c_str());

      } else if (key == "telegramo") {
        telegramo = value;
      // } else if (key == "telegramo") {
      //   if (telegramo) free(telegramo);
      //   telegramo = strdup(value.c_str());

      } else if (key == "hourlyInterval") {
        hourlyInterval = value.toInt();

      } else if (key == "desconectadoWifi") {
        desconectadoWifi = value;

      } else if (key == "desconectadoLuz") {
        desconectadoLuz = value;
      } else if (key == "conectado") {
        conectado = value;
      } else if (key == "control") {
        control = value.toInt();
      }
    }
  }

  configFile.close();

  Serial.println("Configuración cargada.");
}

// CONTADOR DE ENVIO DE DATOS
void handleGetLastSendTime() {
  String response;
  if (shouldSendHello) {
    response = "Nunca";
  } else {
    int secundos = (millis() - lastConnectionTime) / 1000;
    response = String(secundos) + " seg";
  }
  server.send(200, "text/plain", response);
}

void handleStatus() {
  String statusMessage = WiFi.status() == WL_CONNECTED ? "Conectado" : "Desconectado";
  String json = "{";
  json += "\"connected\": " + String(WiFi.status() == WL_CONNECTED ? "true" : "false") + ",";
  json += "\"offlineMinutes\": " + String(offlineMinutes) + ",";
  json += "\"message\": \"Estado actual: " + statusMessage + "\"";
  json += "}";

  server.send(200, "application/json", json);
}

// REESTABLECE EL SERVIDOR LOCAL
void handleRestart() {
  server.send(200, "text/plain", "Reiniciando...");
  delay(1000);
  ESP.restart();
}

// MUESTRA FAVICON EN EL NAVEGADOR
void handleFavicon() {
  // Este es un favicon b�sico en formato PNG (16x16)
  static const uint8_t favicon[] PROGMEM = {
    0x89, 0x50, 0x4E, 0x47, 0x0D, 0x0A, 0x1A, 0x0A, 0x00, 0x00, 0x00, 0x0D, 0x49, 0x48, 0x44, 0x52, 
    0x00, 0x00, 0x02, 0x00, 0x00, 0x00, 0x02, 0x00, 0x08, 0x06, 0x00, 0x00, 0x00, 0xF4, 0x78, 0xD4, 
    0xFA, 0x00, 0x00, 0x00, 0x09, 0x70, 0x48, 0x59, 0x73, 0x00, 0x00, 0x9D, 0x7A, 0x00, 0x00, 0x9D, 
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    0x42, 0x60, 0x82
  };
  
  server.send_P(200, "image/png", (const char*)favicon, sizeof(favicon));
}
